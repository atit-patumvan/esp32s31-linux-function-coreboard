## board/espressif/esp32s31/wireless/firmware/sdkconfig.defaults
```kconfig
# SPDX-License-Identifier: Apache-2.0
CONFIG_ESPTOOLPY_FLASHMODE_DIO=y
CONFIG_ESPTOOLPY_FLASHFREQ_80M=y
CONFIG_ESPTOOLPY_FLASHSIZE_16MB=y
CONFIG_ESP_CONSOLE_UART_DEFAULT=y
CONFIG_ESP_CONSOLE_UART_BAUDRATE=115200
CONFIG_FREERTOS_UNICORE=y
CONFIG_ESP_WIFI_NVS_ENABLED=y
```

## buildroot-external/package/esp-simd/Config.in
```kconfig
config BR2_PACKAGE_ESP_SIMD
	bool "ESP32-S31 XespV SIMD library"
	default y
	help
	  Installs libesp-simd, an explicit XespV 2.2 SIMD API.  The library
	  pins each calling thread to hart 1 before any XespV instruction runs.
```

## buildroot-external/package/s31-tools/Config.in
```kconfig
config BR2_PACKAGE_S31_TOOLS
	bool "ESP32-S31 diagnostic tools"
	default y
	help
	  Installs the compact Wi-Fi and Bluetooth management helpers.
```

## package/esp-linux-bsp/Config.in
```kconfig
config BR2_PACKAGE_HOST_ESP_LINUX_BSP
	bool "host-esp-linux-bsp"
	help
	  Board support scripts for the ESP32-S31 Linux platform.
	  Installs image-packaging tools from esp-linux-bsp into
	  $(HOST_DIR)/share/esp-linux-bsp/tools/.
```
